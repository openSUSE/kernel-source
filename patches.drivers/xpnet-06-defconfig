## patches.drivers/xpnet-06-defconfig
```kconfig
diff -urNp linux-2.6.8/arch/ia64/configs/generic_defconfig linux-2.6.8.SUSE/arch/ia64/configs/generic_defconfig
--- linux-2.6.8/arch/ia64/configs/generic_defconfig	2004-08-30 15:48:11.876060416 +0200
+++ linux-2.6.8.SUSE/arch/ia64/configs/generic_defconfig	2004-08-30 15:48:50.838822674 +0200
@@ -70,6 +70,7 @@ CONFIG_VIRTUAL_MEM_MAP=y
 CONFIG_DISCONTIGMEM=y
 CONFIG_IA64_CYCLONE=y
 CONFIG_IOSAPIC=y
+CONFIG_IA64_SGI_SN_XPC=m
 CONFIG_FORCE_MAX_ZONEORDER=18
 CONFIG_SMP=y
 CONFIG_NR_CPUS=512
@@ -493,6 +494,7 @@ CONFIG_TIGON3=y
 # Wan interfaces
 #
 # CONFIG_WAN is not set
+CONFIG_XPNET=m
 # CONFIG_FDDI is not set
 # CONFIG_HIPPI is not set
 # CONFIG_PPP is not set
@@ -575,6 +577,7 @@ CONFIG_SERIAL_NONSTANDARD=y
 # CONFIG_SYNCLINKMP is not set
 # CONFIG_N_HDLC is not set
 # CONFIG_STALDRV is not set
+CONFIG_FETCHOP=y
 CONFIG_SGI_SNSC=y
 
 #
```
